/*Arduino #4 Sound, PWM, LED Dot Matrix, OLED*/

#include <PCM.h>
#include "LedControl.h"
#include "FontLEDClock.h"
LedControl lc=LedControl(9,13,10,4); // CLK,DIN,CS,Number of LED Module
/**********************************AUDIO***********************************************/
const unsigned char PROGMEM lol[] = {
116, 114, 113, 114, 116, 121, 128, 135, 142, 147, 149, 148, 146, 141, 136, 130, 125, 122, 119,
119, 120, 121, 123, 125, 128, 129, 128, 126, 122, 117, 112, 107, 106, 107, 109, 116, 124, 132,
140, 146, 148, 150, 147, 144, 141, 135, 132, 129, 127, 127, 126, 127, 127, 125, 125, 123, 121,
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137, 135, 132, 129, 125, 123, 123, 119, 118,
};
const unsigned char PROGMEM isus[] = {
129, 128, 128, 129, 128, 128, 128, 128, 127, 127, 128, 127, 127, 127, 127, 127, 128, 127, 127,
127, 128, 126, 127, 128, 127, 127, 128, 128, 127, 128, 128, 128, 128, 128, 128, 127, 128, 127,
127, 127, 127, 127, 127, 127, 127, 127, 127, 128, 128, 128, 129, 128, 128, 128, 128, 127, 127,
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110, 122, 126, 139, 147, 114, 110, 107, 87, 124, 100, 95, 103, 127
};
const unsigned char PROGMEM Round1[] =
{
126, 119, 110, 103, 97, 91, 86, 83, 81, 78, 82, 85, 98, 109, 115, 127, 137, 152, 158, 166, 167,
167, 174, 168, 163, 154, 147, 142, 137, 130, 121, 118, 120, 119, 120, 125, 130, 137, 139, 143,
145, 145, 145, 138, 133, 126, 121, 115, 106, 98, 90, 86, 82, 75, 72, 71, 84, 104, 111, 119, 129,
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160, 163, 167, 166, 164, 164, 160, 152, 146, 145, 145, 145, 143, 137
};
const unsigned char PROGMEM Round2[] =
{
126, 127, 128, 128, 127, 129, 129, 127, 124, 123, 122, 122, 123, 123, 126, 130, 131, 131, 130,
130, 131, 131, 126, 123, 124, 128, 132, 134, 130, 129, 130, 129, 129, 125, 122, 121, 123, 123,
123, 125, 127, 130, 132, 132, 132, 132, 130, 128, 128, 129, 130, 132, 130, 128, 128, 128, 126,
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138, 136, 134, 132, 130, 128, 131, 134, 138, 145, 148, 148, 148, 144,
};
const unsigned char PROGMEM Finalround[] =
{
128, 128, 128, 128, 126, 125, 125, 125, 125, 126, 127, 127, 128, 127, 127, 128, 128, 129, 128,
129, 128, 128, 128, 129, 128, 128, 129, 128, 128, 128, 128, 129, 129, 129, 129, 129, 129, 129,
130, 130, 129, 128, 128, 127, 126, 126, 127, 127, 128, 128, 128, 128, 128, 127, 128, 126, 126,
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168, 139, 111, 92, 117, 140, 158, 155, 124, 101, 92, 108, 136, 139, 129
};
/********************************PONG DATA*********************************************/
unsigned long pongdelay = 100,
pongtime = 0;
uint8_t
Pong[4],
//[x , y, x direct, y direct]
pongstatus = 1,
address;
//[used module, x value on module]
/********************************BAR DATA**********************************************/
unsigned long bartime=0;
uint16_t
Bar1[] = {2,4,3,2,0},
//Player 1 bar [right edge, left edge, module, col, bar
direction]
Bar2[] = {2,4,0,5,0},
//Player 2 bar
Bar1b[]= {2,4,3,2,0}, //Player 1 bar backup data
Bar2b[]= {2,4,0,5,0}; //Player 2 bar backup data
/********************************SETTING***********************************************/
unsigned long hittime[2],
hitdelay = 200,
songtime;
uint8_t
Order=0,
hitstatus=0,
randomNO,

//Hittime for each bar

//Order in startgame()

intensity=11,
playeramount,
score1 = 0,
score2 = 0,
song = 0,
Roundd = 0;
boolean
Start = false;

//Score for Player 1 and 2

//Start game signal

/*****************************POTENTIOMETER********************************************/
uint16_t

val,
//Fisrt value of potentiometer
vallast;
//Last value of potentiometer
unsigned long potentdelay=50, //Potentiometer delay
potenttime=0;
//Value to coolect millis()
/*******************************DEBOUNCE***********************************************/
unsigned long lastDebounceTime[]={0,0},
debounceDelay = 100;
int
buttonState[2],
lastButtonState[] = {LOW,LOW};
/***************************************************************************************/
void setup() {
int devices=lc.getDeviceCount();
for(int address=0;address<devices;address++) {
lc.shutdown(address,false);
lc.setIntensity(address,11);
lc.clearDisplay(address);
}
val = analogRead(A0);
pinMode(0,INPUT_PULLUP);
pinMode(2,INPUT_PULLUP);
Serial.begin(9600);
}
/***************************************************************************************/
void setupdata(uint16_t Array[5],uint16_t data[5]){ //Copy data array to array
for(int x = 0; x < 5; x++){
Array[x] = data[x];
}
}
/***************************************************************************************/
void cleardisplay(){ //Clear all led
for(int address=0;address<4;address++) {

lc.clearDisplay(address);
}
}
/***************************************************************************************/
void plotNodelay (uint8_t x, uint8_t y, uint8_t value) { //Control LED intput : x , y , LED status
uint8_t addressplot;
if (x >= 0 && x <= 7) { addressplot = 3; }
if (x >= 8 && x <= 15) { addressplot = 2; x = x - 8; }
if (x >= 16 && x <= 23) { addressplot = 1; x = x - 16;}
if (x >= 24 && x <= 31) { addressplot = 0; x = x - 24;}
if (value == 1) {
lc.setLed(addressplot, y, x, true);
} else {
lc.setLed(addressplot, y, x, false);
}
}
/***************************************************************************************/
void print_tiny_char(uint8_t x, uint8_t y, char c)
{
uint8_t dots;
if (c >= 'A' && c <= 'Z' || (c >= 'a' && c <= 'z') ) { c &= 0x1F; } // A-Z maps to 1-26
else if (c >= '0' && c <= '9') { c = (c - '0') + 32; }
else if (c == ' ') { c = 0; } // space
else if (c == '.') { c = 27; } // full stop
else if (c == ':') { c = 28; } // colon
else if (c == '\''){ c = 29; } // single quote mark
else if (c == '!') { c = 30; } // single quote mark
else if (c == '?') { c = 31; } // single quote mark
for (uint8_t col = 0; col < 3; col++) {
dots = pgm_read_byte_near(&mytinyfont[c][col]);
for (uint8_t row = 0; row < 5; row++) {
if (dots & (16 >> row))
plotNodelay(x + col, y + row, 1);
else
plotNodelay(x + col, y + row, 0);
}
}
}
/***************************************************************************************/
void Random(int pos,int last){ //Random
randomSeed(analogRead(A2));
randomNO= random(0,last);

Pong[pos]=randomNO;
}
/***************************************************************************************/
void directpong (int left, int right){
if(Pong[0] == left )
{Pong[2] = 0;}
else if(Pong[0] == right) {Pong[2] = 1;}
if(Pong[1] == 0 )
{Pong[3] = 0;}
else if(Pong[1] == 7) {Pong[3] = 1;}
if(Pong[2] == 0)
{Pong[0] = Pong[0] + 1;}
else
{Pong[0] = Pong[0] - 1;}
if(Pong[3] == 0)
{Pong[1] = Pong[1] + 1;}
else
{Pong[1] = Pong[1] - 1;}
}
/***************************************************************************************/
void clearbar(uint16_t bar[5]){
lc.setColumn(bar[2],bar[3],B00000000);
}
/***************************************************************************************/
void printbar(uint16_t bar[5]){
for(int i = bar[0]; i <= bar[1]; i++){
lc.setLed(bar[2], i , bar[3], true);
}
}
/***************************************************************************************/
void plot(){
if(pongstatus==1){
uint8_t x = Pong[0];
if (x>=0 && x<=7) {address = 3; x = x; }
if (x>=8 && x<=15) {address = 2; x = x - 8 ;}
if (x>=16 && x<=23) {address = 1; x = x - 16;}
if (x>=24 && x<=31) {address = 0; x = x - 24;}
lc.setLed(address, Pong[1] , x, true);
if(millis() - pongtime > pongdelay){
pongtime=millis();
lc.setLed(address, Pong[1] , x, false);
if(Pong[0] < 28 && Pong[0] > 3){
hitstatus = 0;
}
if(hitstatus == 1){
directpong(3,28);
}
else if(hitstatus == 0){
if(playeramount == 1){
directpong(0,28);

}
else{
directpong(0,31);
}
}
}
}
}
/***************************************************************************************/
void plotBar(uint16_t bar[5]){
if(bar[4] == 1 && bar[1] < 7){
clearbar(bar);
bar[0] = bar[0] + 1;
bar[1] = bar[1] + 1;
printbar(bar);
}
if(bar[4] == 0 && bar[0] > 0){
clearbar(bar);
bar[0] = bar[0] - 1;
bar[1] = bar[1] - 1;
printbar(bar);
}
}
/***************************************************************************************/
void fade_down() {
//fade from global intensity to 1
for (uint8_t i = intensity; i > 0; i--) {
for (uint8_t address = 0; address < 4; address++) {
lc.setIntensity(address, i);
}
delay(30); //change this to change fade down speed
}
cleardisplay(); //clear display completely (off)
//reset intentsity to global value
for (uint8_t address = 0; address < 4; address++) {
lc.setIntensity(address, intensity);
}
}
/***************************************************************************************/
void Potentiometer(){
if(millis() - potenttime > potentdelay){

potenttime = millis();
vallast = analogRead(A0);
int diff = vallast-val;
if(diff > 30 || diff < -30){
if(diff > 1){
Bar1[4] = 0;
}
if(diff < -1){
Bar1[4] = 1;
}
val = vallast;
}
else{
Bar1[4] = 2;
}
}
}
/***************************************************************************************/
void button(int x){
int reading = digitalRead(x);
if (reading != lastButtonState[x-2]) {lastDebounceTime[x-2] = millis();}
if ((millis() - lastDebounceTime[x-2]) > debounceDelay) {
if (reading != buttonState[x-2]) {
buttonState[x-2] = reading;
if (buttonState[x-2] != LOW ){
if(Order == 1 || Order == 3){
Order++;
tone(11,500,50);
playeramount=x-1;
}
}
}
}
lastButtonState[x-2] = reading;
}
/***************************************************************************************/
void bar2direct(){
if(buttonState[0] == 1){
Bar2[4] = 0;
}
else if(buttonState[1] == 1){
Bar2[4] = 1;
}
else if (buttonState[0] == 0 && buttonState[1] == 0){

Bar2[4] = 2;
}
}
/***************************************************************************************/
void startgame(){
if(Order == 0){
char START[] = "START?";
for(int i = 0; i < 6; i++){
print_tiny_char((i * 4) + 5, 1, START[i]);
delay(10);
}
Order = 1;
}
else if(Order == 2){
fade_down();
char OR[] = "1 OR 2";
for(int i = 0; i < 6; i++){
print_tiny_char((i * 4) + 4, 1, OR[i]);
}
Order=3;
}
else if(Order == 4){
fade_down();
char count[] = "321";
for(int i = 0; i < 3; i++){
print_tiny_char(14, 1, count[i]);
tone(11,500);
delay(300);
noTone(11);
fade_down();
}
Order = 5;
}
}
/***************************************************************************************/
void settingstart(){
if(Order == 5){
pinMode(11,OUTPUT);
setupdata(Bar1, Bar1b),
setupdata(Bar2, Bar2b);
if(playeramount == 1){
Bar2[0]=0,Bar2[1]=7;}
printbar(Bar1),
printbar(Bar2),

bartime=0;
Random(1,8),
Random(2,2),
Random(3,2),
Pong[0] = 16,
pongdelay = 100,
pongstatus = 1;
plotNodelay(Pong[0], Pong[1], 1);
hittime[0],hittime[1],hitstatus = 0, 0, 0;
buttonState[0], buttonState[1] = 0, 0;
val = analogRead(A0),
potenttime = 0;
delay(1000);
if(Roundd == 0){
startPlayback(Round1, sizeof(Round1));
delay(800);
}
else if(Roundd == 1){
startPlayback(Round2, sizeof(Round2));
delay(800);
}
else if(Roundd == 2){
startPlayback(Finalround, sizeof(Finalround));
delay(800);
}
Order=6;
Start=true;
}
}
/***************************************************************************************/
void endgame(){
cleardisplay();
Start = false;
char END[3]="END";
for(int i=0;i<3;i++){
print_tiny_char((i * 4)+11, 1, END[i]);
}
tone(11,500);
delay(3000);
noTone(11);
fade_down();
Order=0;
Roundd=0;

score1 = 0;
score2 = 0;
Serial.println(score1);
Serial.println(score2);
}
/***************************************************************************************/
void hitting(){
uint16_t bar[5];
int nobar, barhit, scorepos, shifttopbar = 0, shiftbotbar = 0;
if(Pong[0] >= 28 || Pong[0] <= 3){
if(Pong[0] <= 3){
setupdata(bar, Bar1);
nobar = 0, barhit = 3, scorepos = 1;
}
else if(Pong[0] >= 28){
setupdata(bar, Bar2);
nobar = 1, barhit = 28, scorepos = 30;
}
if(Pong[3] == 0 && Pong[1] > 0){
shifttopbar = -1;
}
else if(Pong[3] == 1 && Pong[1] < 7){
shiftbotbar = 1;
}
if(Pong[0] == barhit){
if(Pong[1] >= bar[0] + shifttopbar && Pong[1] <= bar[1] + shiftbotbar){
if(millis() - hittime[nobar] > hitdelay){
hittime[nobar] = millis();
if(bar[4] != Pong[3] && pongdelay < 150 && pongdelay > 80){
pongdelay = pongdelay - 10;
}
else if(bar[4] == Pong[3] && pongdelay < 150 && pongdelay > 80){
pongdelay = pongdelay + 10;
}
hitstatus=1;
}
}
}
else if(Pong[0] == scorepos && score1 <= 2 && score2 <= 2){
delay(500);
pongstatus = 0;
Roundd++;
if(nobar == 1){
lc.setLed(3, score1+3, 0, true);

score1++;
}
else{
lc.setLed(0, score2+3, 7, true);
score2++;
}
Serial.println(score1);
Serial.println(score2);
}
}
if(score1 == 2 || score2 == 2){
startPlayback(lol, sizeof(lol));
pongstatus = 0;
playeramount=0;
delay(1000);
pinMode(11,INPUT);
endgame();
}
}
/***************************************************************************************/
void sound(){
if(Pong[1] == 0 || Pong[1] == 7 || hitstatus == 1){
startPlayback(isus, sizeof(isus));
}
}
/***************************************************************************************/
void loop(){
if(Start==true){
if(pongstatus==0){
stopPlayback();
startPlayback(lol, sizeof(lol));
delay(500);
clearbar(Bar1),clearbar(Bar2);
Order=5;
settingstart();
}
printbar(Bar1),printbar(Bar2);
button(2),button(3);
Potentiometer();
if(millis()%bartime>50){
bartime=millis();
bar2direct();
plotBar(Bar1);

plotBar(Bar2);
}
sound();
hitting();
plot();
}
else{
if((millis() - songtime) % 300 == 0 && millis() - songtime <= 4800){
if(song == 0){
tone(11,262,50);
}
else{
tone(11,247,50);
}
}
else if(millis() - songtime > 2400){
song = 1;
}
if(millis() - songtime > 4800){
songtime = millis();
song = 0;
}
startgame();
button(2),button(3);
settingstart();
}
}
